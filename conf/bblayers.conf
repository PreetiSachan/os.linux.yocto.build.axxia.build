## conf/bblayers.conf
```bitbake
BBPATH = "${TOPDIR}"
BBFILES ?= ""
METALAYER_PREFIX = "intel-embedded-system-enabling/"

BBLAYERS ?= " \
  ${TOPDIR}/../${METALAYER_PREFIX}meta \
  ${TOPDIR}/../${METALAYER_PREFIX}meta-poky \
  ${TOPDIR}/../${METALAYER_PREFIX}meta-yocto-bsp \
  ${TOPDIR}/../${METALAYER_PREFIX}meta-openembedded/meta-oe \
  ${TOPDIR}/../${METALAYER_PREFIX}meta-openembedded/meta-networking \
  ${TOPDIR}/../${METALAYER_PREFIX}meta-openembedded/meta-filesystems \
  ${TOPDIR}/../${METALAYER_PREFIX}meta-openembedded/meta-python \
  ${TOPDIR}/../${METALAYER_PREFIX}meta-openembedded/meta-perl \
  ${TOPDIR}/../${METALAYER_PREFIX}meta-security \
  ${TOPDIR}/../${METALAYER_PREFIX}meta-security/meta-tpm \
  ${TOPDIR}/../${METALAYER_PREFIX}meta-virtualization \
  ${TOPDIR}/../${METALAYER_PREFIX}meta-intel \
  ${TOPDIR}/../${METALAYER_PREFIX}meta-intel-axxia/meta-intel-bsp \
  ${TOPDIR}/../${METALAYER_PREFIX}meta-intel-axxia/meta-intel-distro \
  "
```
